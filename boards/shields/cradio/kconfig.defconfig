## boards/shields/cradio/kconfig.defconfig
```kconfig
if SHIELD_CRADIO_DONGLE

config ZMK_SPLIT
    default y

config ZMK_SPLIT_ROLE_CENTRAL
    default y

config ZMK_SPLIT_BLE_CENTRAL_PERIPHERALS
    default 2
    
endif 

if ZMK_SPLIT_ROLE_CENTRAL

config ZMK_KEYBOARD_NAME
    default "Raii"
endif

config ZMK_SPLIT
    default y
```
